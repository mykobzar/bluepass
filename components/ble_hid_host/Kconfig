## components/ble_hid_host/Kconfig
```kconfig
menu "BLE HID host"

    config BLE_DEBUG_LOG
        bool "Enable verbose BLE diagnostic logging"
        default n
        help
            Log all BLE GAP/GATT events, connection state transitions, report
            descriptor discovery, and CCCD subscription results to the in-memory
            ring buffer (readable from the BLE log spoiler in the web UI) and to
            the serial console via ESP_LOGI.

            When disabled blog() is a no-op: no serial output, no ring-buffer
            writes. The BLE log spoiler in the web UI will be empty.

endmenu
```

## components/fido2/Kconfig
```kconfig
menu "FIDO2 / Passkey authenticator"

    config FIDO2_DEBUG_LOG
        bool "Enable verbose FIDO2 diagnostic logging"
        default n
        help
            Log every HID packet receive event, CTAPHID dispatch header, CBOR
            command code, and per-packet stack HWM to the in-memory diagnostic
            buffer (readable from the Passkey tab in the web UI).

            When disabled only command results (#N cmd → STATUS) and errors are
            logged, which is sufficient for normal production use.

endmenu
```
